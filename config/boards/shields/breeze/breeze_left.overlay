/*
 * Copyright (c) 2020 Pete Johanson
 *
 * SPDX-License-Identifier: MIT
 */

#include "breeze.dtsi"

&kscan0 {
		col-gpios
		        = <&pro_micro_d 5  GPIO_ACTIVE_HIGH>
			, <&pro_micro_d 4  GPIO_ACTIVE_HIGH>
			, <&pro_micro_d 3  GPIO_ACTIVE_HIGH>
		        , <&pro_micro_d 2  GPIO_ACTIVE_HIGH>
		        , <&pro_micro_d 16 GPIO_ACTIVE_HIGH>
		        ;

};
