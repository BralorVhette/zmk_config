/* Copyright 2021 eithanshavit
 *
 * This program is free software: you can redistribute it and/or modify
 * it under the terms of the GNU General Public License as published by
 * the Free Software Foundation, either version 2 of the License, or
 * (at your option) any later version.
 *
 * This program is distributed in the hope that it will be useful,
 * but WITHOUT ANY WARRANTY; without even the implied warranty of
 * MERCHANTABILITY or FITNESS FOR A PARTICULAR PURPOSE.  See the
 * GNU General Public License for more details.
 *
 * You should have received a copy of the GNU General Public License
 * along with this program.  If not, see <http://www.gnu.org/licenses/>.
 */

#include <behaviors.dtsi>
#include <dt-bindings/zmk/keys.h>

enum layer_names {
    _MAIN,
    _LOWER,
    _RAISE,
};

#define LOWER MO(_LOWER)
#define RAISE MO(_RAISE)

const uint16_t PROGMEM keymaps[][MATRIX_ROWS][MATRIX_COLS] = {

  [_MAIN] = LAYOUT(
  //┌────────┬────────┬────────┬────────┬────────┬────────┐                          ┌────────┬────────┬────────┬────────┬────────┬────────┐┌────────┬────────┬────────┐
     &kp ESC, &kp N1, &kp N2,  &kp N3,  &kp N4,  &kp N5,                             &kp N6,  &kp N7,  &kp N8,  &kp N9,  &kp N0,  &kp BSPC, &kp MINUS, &kp EQUAL, &kp GRAVE,
  //├────────┼────────┼────────┼────────┼────────┼────────┤                          ├────────┼────────┼────────┼────────┼────────┼────────┤├────────┼────────┼────────┤
     &kp TAB, &kp Q,   &kp W,   &kp E,   &kp R,   &kp T,                              &kp Y,   &kp U,   &kp I,   &kp O,   &kp P,  &kp ENTER, &kp LBKT, &kp RBKT, &kp BSLH,
  //├────────┼────────┼────────┼────────┼────────┼────────┤                          ├────────┼────────┼────────┼────────┼────────┼────────┤├────────┼────────┼────────┤
     &kp LCTL, &kp A,  &kp S,   &kp D,   &kp F,   &kp G,                              &kp H,   &kp J,   &kp K,   &kp L,   &kp SEMI, &kp SQT,          &kp UP,
  //├────────┼────────┼────────┼────────┼────────┼────────┤                          ├────────┼────────┼────────┼────────┼────────┼────────┤├────────┼────────┼────────┤
     &kp LSHFT, &kp Z,  &kp X,   &kp C,   &kp V,   &kp B,                            &kp N,   &kp M, &kp COMMA, &kp DOT, &kp FSLH, &kp RSHFT, &kp LEFT, &kp DOWN, &kp RIGHT,
  //└────────┴────────┼────────┼────────┼────────┼────────┼────────┐        ┌────────┼────────┼────────┼────────┴────────┴────────┴────────┘└────────┴────────┴────────┘
                               &kp LCTL, &kp LALT, &kp LGUI, &kp SPACE,     &kp SPACE, RAISE,  LOWER,   &kp DEL
  //                           └────────┴────────┴────────┴────────┘        └────────┴────────┴────────┴────────┘
  ),

  [_LOWER] = LAYOUT(
  //┌────────┬────────┬────────┬────────┬────────┬────────┐                          ┌────────┬────────┬────────┬────────┬────────┬────────┐┌────────┬────────┬────────┐
     RESET,   _______, _______, _______, _______, _______,                            _______, _______, _______, _______, _______, _______, &kp MUTE, &kp VOLD, &kp VOLU,
  //├────────┼────────┼────────┼────────┼────────┼────────┤                          ├────────┼────────┼────────┼────────┼────────┼────────┤├────────┼────────┼────────┤
     _______, _______, _______, _______, _______, _______,                            _______, _______, _______, _______, _______, _______,  _______, _______, _______,
  //├────────┼────────┼────────┼────────┼────────┼────────┤                          ├────────┼────────┼────────┼────────┼────────┼────────┤├────────┼────────┼────────┤
     _______, _______, _______, _______, _______, _______,                            _______, _______, _______, _______, _______, _______,           _______,
  //├────────┼────────┼────────┼────────┼────────┼────────┤                          ├────────┼────────┼────────┼────────┼────────┼────────┤├────────┼────────┼────────┤
     _______, _______, _______, _______, _______, _______,                            _______, _______, _______, _______, _______, _______, _______,  _______, _______,
  //└────────┴────────┼────────┼────────┼────────┼────────┼────────┐        ┌────────┼────────┼────────┼────────┴────────┴────────┴────────┘└────────┴────────┴────────┘
                                _______, _______, _______, _______,          _______, _______, _______, _______
  //                           └────────┴────────┴────────┴────────┘        └────────┴────────┴────────┴────────┘
  ),

  [_RAISE] = LAYOUT(
  //┌────────┬────────┬────────┬────────┬────────┬────────┐                          ┌────────┬────────┬────────┬────────┬────────┬────────┐┌────────┬────────┬────────┐
     _______, _______, _______, _______, _______, _______,                         _______, &kp BSPC, &kp KP_PLUS, &kp KP_MULTIPLY, &kp KP_MINUS, _______,  _______, _______, _______,
  //├────────┼────────┼────────┼────────┼────────┼────────┤                          ├────────┼────────┼────────┼────────┼────────┼────────┤├────────┼────────┼────────┤
     _______, _______, _______, _______, _______, _______,                         _______, &kp KP_N7,  &kp KP_8,    &kp KP_N9,     &kp KP_PLUS, _______,  _______, _______, _______,
  //├────────┼────────┼────────┼────────┼────────┼────────┤                          ├────────┼────────┼────────┼────────┼────────┼────────┤├────────┼────────┼────────┤
     _______, _______, _______, _______, _______, _______,                         _______, &kp KP_N4,  &kp KP_N5,   &kp KP_N6,    &kp KP_ENTER, _______,           _______,
  //├────────┼────────┼────────┼────────┼────────┼────────┤                          ├────────┼────────┼────────┼────────┼────────┼────────┤├────────┼────────┼────────┤
     _______, _______, _______, _______, _______, _______,                         _______, &kp KP_N1,  &kp KP_N2,   &kp KP_N3,   _______, _______, _______,  _______, _______,
  //└────────┴────────┼────────┼────────┼────────┼────────┼────────┐        ┌────────┼────────┼────────┼────────┴────────┴────────┴────────┘└────────┴────────┴────────┘
                                _______, _______, _______, _______,        _______, _______, &kp KP_N0, &kp KP_DOT
  //                           └────────┴────────┴────────┴────────┘        └────────┴────────┴────────┴────────┘
  )
};
